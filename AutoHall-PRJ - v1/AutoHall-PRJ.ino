//Librerias
#include <Wire.h>    //Por esta mamada no podia leer el MLX-90614(Termometro)
#include <NewPing.h> //Multi-US-Sensor(Esta libreria me permitio crear dos o mas lecturas de sensores en conjunto, ya podemos leer dos US y el DHT con el MLX)
#include <DHT.h>
#include <Servo.h>
#include <SPI.h>
#include <Adafruit_MLX90614.h> //Termico
#include <Adafruit_GFX.h>      //Esta libreria actua como simplificador de sintaxis para la escritura en la pantalla Oled
#include <Adafruit_SSD1306.h>  //Oled Display(El Mamalon)
//#include <LiquidCrystal_I2C.h> //Pantalla de Cristal Liquido (Pantalla de la Maestra)
///////////////////////////////////////////////////All Define's
//Estos son los valores de  (Altura x Ancho) de la pantalla Oled y el reset, para limpiarlo,
//de lo contrario nos muestra caracteres cargados para demo del fabricante (Quita los "display.clearDisplay();" para coprobarlo)
#define SCREEN_WIDTH 128
#define SCREEN_HEIGHT 64
#define OLED_RESET -1
//Sensor de Temperatura
#define DHTTYPE DHT11
#define LdN 2 //Salida LED (Rejected)
#define LdY 3 //Salida LED (Aproved)
#define LdH 4 //Salida LED (Cupo Disponible)
//Esta distancia es la establecida para empezar a detectar movimineto, asi no gastamos recursos a lo pendejo buscando a 20 metros
#define Max_Dis 100
#define Min_Dis 5
#define Echo1 6 //Sensor US-1
#define Trig1 7 //Sensor US-1
#define Echo2 8 //Sensor US-2
#define Trig2 9 //Sensor US-2
//////////////////////////////////////////Hardware Intance's
Servo Door1;
Servo Door2;
DHT dht(5, DHTTYPE);
NewPing sono1(Trig1, Echo1, Max_Dis);
NewPing sono2(Trig2, Echo2, Max_Dis);
/////////////////////////////////////////Global Var's
int PrsnInside = 10;
float TempObj = 0;
unsigned int distance;
long unsigned int Tiempo;
/////////////////////////////////////////Dedicated Var's
Adafruit_SSD1306 display(SCREEN_WIDTH, SCREEN_HEIGHT, &Wire, OLED_RESET);
Adafruit_MLX90614 mlx = Adafruit_MLX90614();

static const unsigned char PROGMEM datos_imagen[2] = {
0x00, 0x00, 0x00, 0x00, 0x00, 0x00, 0x00, 0x00, 0x00, 0x00, 0x00, 0x00, 0x00, 0x00, 0x00, 
0x00, 0x00, 0x00, 0x00, 0x00, 0x00, 0x00, 0x00, 0x00, 0x00, 0x00, 0x00, 0x00, 0x00, 0x00, 
0x00, 0x00, 0x00, 0x00, 0x00, 0x00, 0x00, 0x00, 0x00, 0x00, 0x00, 0x00, 0x00, 0x00, 0x00, 
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0x00, 0x00, 0x00, 0x00, 0x00, 0x00, 0x00, 0x00, 0x00, 0x00, 0x00, 0x00, 0x00, 0x00, 0x00
};

void setup()
{

  Serial.begin(9600);

  dht.begin();
  mlx.begin();

  Door1.attach(10);
  Door2.attach(11);

  Door1.write(0);
  Door2.write(0);

  display.begin(SSD1306_SWITCHCAPVCC, 0x3C);
  display.clearDisplay();
  display.display();

  pinMode(LdH, OUTPUT);
  pinMode(LdN, OUTPUT);
  pinMode(LdY, OUTPUT);

  delay(3000);
  display.clearDisplay();
  display.setTextSize(1);
  display.setTextColor(WHITE);
  display.setCursor(0, 4);
  display.drawBitmap(0, 1, datos_imagen, 120, 60, SSD1306_WHITE);
  display.display();
  display.clearDisplay();

  delay(5000);
  display.setCursor(0, 20);
  display.clearDisplay();
  display.setTextSize(2);
  display.setTextColor(WHITE);
  display.println("Devel");
  display.print("  Invictus");
  display.display();
  delay(3500);

  delay(5000);
  display.clearDisplay();
  display.setTextSize(1);
  display.setTextColor(WHITE);
  display.setCursor(0, 4);
  display.println("Bienvenido!!");
  digitalWrite(LdH, HIGH);
  display.display();
  delay(3500);
}

void loop()
{

  float TempR = dht.readTemperature();
  int Dist = sono1.ping_cm();
  int Dist2 = sono2.ping_cm();
  int flag = 0;

  
  if (PrsnInside < 30)
  {



    if (Dist > Min_Dis)
    {
      flag = 0;
      Tiempo = millis();
    }
    if (Dist <= Min_Dis && Dist > 0 && flag == 0)
    {
      flag = 1;
      Tiempo = millis();
    }
    if (flag == 1)
    {
      if (millis() - Tiempo > 3000)
      {
        flag = 2;
      }
    }

    display.clearDisplay();

    display.setTextSize(1);
    display.setTextColor(WHITE);
    display.setCursor(0, 4);
    display.println("Temperatura \n Ambiente: ");

    display.setTextSize(1);
    display.setCursor(50, 0);
    display.print("\n              ");
    display.println(TempR, 1);

    display.setCursor(110, 0);
    display.print("\n                   *C");

    switch (flag)
    {
    case 0:
      display.setTextSize(1);
      display.setTextColor(WHITE);
      display.setCursor(0, 20);
      display.println("Temperatura \n Este Wey: ");

      display.setTextSize(1);
      display.setCursor(50, 17);
      display.print("\n              ");
      display.print(" F.");
      digitalWrite(LdH, HIGH);
      break;
    case 1:
      display.setTextSize(1);
      display.setTextColor(WHITE);
      display.setCursor(0, 20);
      display.println("Temperatura \n Este Wey: ");

      display.setTextSize(1);
      display.setCursor(50, 17);
      display.print("\n              ");
      display.println(mlx.readObjectTempC(), 1);
      display.setCursor(110, 17);
      display.print("\n                   *C");
      digitalWrite(LdH, HIGH);
      delay(3500);
      TempObj = mlx.readObjectTempC();
      if (TempObj > 0 && TempObj < 30.0)
      {
        display.clearDisplay();
        display.setTextSize(1);
        display.setTextColor(WHITE);
        display.setCursor(10, 0);
        display.println("Esa mmda ni humana es");
      }
      else if (TempObj > 30.0 && TempObj <= 37.5)
      {
        display.clearDisplay();
        display.setTextSize(1);
        display.setTextColor(WHITE);
        display.setCursor(0, 20);
        display.println("Adelante \n Mi Broooo: ");
        display.println(TempObj);
        display.display();
        for (int i = 0; i <= 180; i++)
        {
          Door1.write(i);
          delay(25);
        }
               for (int i = 0; i <= 4; i++)
              {
                digitalWrite(LdY, HIGH);
                delay(500);
                digitalWrite(LdY, LOW);
                delay(500);
              }
        for (int i = 179; i > 0; i--)
        {
          Door1.write(i);
          delay(25);
        }
        PrsnInside++;
      }
      else if (TempObj > 37.6)
      {
        display.clearDisplay();
        display.setTextSize(1);
        display.setTextColor(WHITE);
        display.setCursor(0, 20);
        display.println("Vete  ALV \n Traes Fiebre!!: ");
        display.println(TempObj);
        display.display();
        for (int i = 0; i < 10; i++)
        {
          digitalWrite(LdN, HIGH);
          delay(500);
          digitalWrite(LdN, LOW);
          delay(500);
        }
      }
      break;
    case 2:
      // display.clearDisplay();
      // display.setTextSize(1);
      // display.setTextColor(WHITE);
      // display.setCursor(10, 4);
      // display.println("NEL, no se leyo nada");
      break;
    }
  }
 

if (Dist2 <= 2)
    {
  if (PrsnInside > 0)
  {
      for (int i = 0; i <= 180; i++)
      {
        Door2.write(i);
        delay(25);
      }
      delay(5000);
      for (int i = 179; i > 0; i--)
      {
        Door2.write(i);
        delay(25);
      }
      PrsnInside--;
    }
  }


 }
  else
  {
    display.clearDisplay();
    display.setTextSize(1);
    display.setTextColor(WHITE);
    display.setCursor(0, 4);
    display.println("Sala Llena!!");
    digitalWrite(LdH, LOW);
  }

  display.display();
  delay(100);
}
